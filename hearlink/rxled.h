// Цветной светодиод приёмника (WS2812 на плате S3: вывод 48, у плат поновее — 38).
//
// Владелец 07.10: «приемники — в спячке ничего не светится, в активном режиме плавно медленно пульсирует зелёный цвет
// rgb светодиода, когда эфир активен, более частая пульсация жёлтым цветом. При запуске и поиске передатчика моргание
// синим цветом, если не находит передатчик — моргает 4 секунды красным и засыпает».
//
//   спит (ожидание), выключен с передатчика ........ не светится
//   запуск, поиск передатчика, сигнал пропал ....... мигает синим (0,2 с из 0,6 с)
//   работает, в эфире тихо ......................... плавно и медленно «дышит» зелёным (вдох-выдох 4,4 с)
//   работает, в эфире идёт звук .................... так же плавно «дышит» жёлтым, чуть чаще (3,2 с)
//   передатчик не найден ........................... 4 с мигает красным и засыпает
//   идёт обновление прошивки по радио .............. плавно «дышит» фиолетовым
//   «Показати себе» с передатчика .................. вместе со звуком часто мигает белым (в любом состоянии)
//     (владелец 07.10: «при нажатии показать себя на передатчике — приемник, кроме звука, моргает белым цветом»)
//
// «Эфир активен» понят так: в принятом звуке есть что-то громче тишины (и на передатчике не включена «Тиша»).
// Жёлтый держится ещё полторы секунды после звука — чтобы не мигать цветами на паузах между словами.
// Яркость небольшая (LED_MAX из 255): светодиод на плате яркий, а прибор лежит перед человеком.
// Светодиод ведёт своя задача (ledTask, см. в конце); перед сном она гасит светодиод, и круг сна не начнётся, пока он горит.
#pragma once

// Наибольшая яркость (из 255) — по настройке «Світлодіод» (с 2.32): выключен, слабо, обычно, ярко. «Обычно» — прежние 26:
// светодиод на плате яркий, а прибор лежит перед человеком. Выключенный не светится ни в каком состоянии, кроме
// «Показати себе» — это прямая команда оператора, который ищет приёмник глазами.
static inline int ledMax() {
  static const uint8_t L[4] = { 0, 8, 26, 80 };
  return L[cfg.rxLed > 3 ? 2 : cfg.rxLed];
}
#define LED_MAX ledMax()
static volatile uint8_t ledR, ledG, ledB;
static volatile uint8_t ledState;   // для отчёта: 0 не светится, 1 синий, 2 зелёный, 3 жёлтый, 4 красный, 5 белый, 6 фиолетовый
static volatile bool ledOta;        // идёт обновление прошивки по радио (ставит ota.h через главный цикл)
static bool ledReady;
static volatile uint32_t ledWrites;   // сколько раз светодиоду послан новый цвет (отчёт обнуляет раз в секунду)

static void ledSet(uint8_t r, uint8_t g, uint8_t b) {
  if (ledReady && r == ledR && g == ledG && b == ledB) return;
  ledR = r;
  ledG = g;
  ledB = b;
  ledReady = true;
  ledWrites = ledWrites + 1;
  for (int pin : { 48, 38 }) rgbLedWrite(pin, r, g, b);
}
static bool ledDark() {
  return !(ledR | ledG | ledB);
}
static const char *ledName() {
  static const char *const N[] = { "не світиться", "синій", "зелений", "жовтий", "червоний", "білий", "фіолетовий" };
  return N[ledState > 6 ? 0 : ledState];
}

static void ledTick(uint32_t now) {
  static uint32_t last;
  if (ledReady && now - last < 4) return;
  last = now;
  uint8_t pw = rxPower, why = rxPowerWhy;
  if (rxIdentifyUntil && now < rxIdentifyUntil) {   // «Показати себе»: белым, заметно — приёмник ищут глазами
    uint8_t v = (now % 300) < 150 ? (LED_MAX < 26 ? 40 : LED_MAX + 14) : 0;
    ledState = 5;
    ledSet(v, v, v);
    return;
  }
  if (!LED_MAX) {   // выключен в настройках
    ledState = 0;
    ledSet(0, 0, 0);
    return;
  }
  if (ledOta) {   // идёт обновление прошивки по радио: плавно «дышит» фиолетовым (2 с), пока не кончится
    float k = 0.5f - 0.5f * cosf(2 * PI * (now % 2000) / 2000.0f);
    uint8_t v = (uint8_t)(2 + (LED_MAX - 2) * k);
    ledState = 6;
    ledSet(v, 0, v);
    return;
  }
  if (pw == PW_STANDBY || (pw == PW_GOING && why == WHY_OFF)) {
    ledState = 0;
    ledSet(0, 0, 0);
    return;
  }
  if (pw == PW_GOING) {   // передатчик не найден: красным, пока идёт отсчёт до сна
    ledState = 4;
    ledSet(((now - rxPowerAt) % 400) < 200 ? LED_MAX : 0, 0, 0);
    return;
  }
  bool lost = !rLastRxMs || msSince(rLastRxMs, now) > 700;
  if ((pw != PW_RUN && pw != PW_STARTING) || lost) {   // запуск, поиск, просыпаемся, сигнал пропал
    ledState = 1;
    ledSet(0, 0, (now % 600) < 200 ? LED_MAX : 0);
    return;
  }
  // Работа: «дыхание». Владелец 07.10 (вечер): «пульсацию работы приемников сделать медленной и плавной» — было 3,2 с
  // зелёным и 0,9 с жёлтым, с резкой сменой цвета и ступеньками яркости. Теперь:
  //  — вдох-выдох 4,4 с в тишине и 3,2 с при звуке (разница видна, но суеты нет);
  //  — фаза общая и непрерывная: при смене темпа яркость не прыгает;
  //  — зелёный в жёлтый (и обратно) переходит плавно, за секунду с небольшим;
  //  — ступеньки убраны: у светодиода при такой яркости всего 26 уровней, поэтому между соседними уровнями он
  //    «дрожит» с частотой 100 раз в секунду (доля времени на верхнем уровне = дробная часть) — глаз видит ровный ход.
  bool sound = rxSoundMs && msSince(rxSoundMs, now) < 1500;
  static float phase, mix, errR, errG;
  static uint32_t prev;
  float dt = prev ? (now - prev) / 1000.0f : 0;
  prev = now;
  if (dt > 0.2f) dt = 0.2f;
  mix += ((sound ? 1.0f : 0.0f) - mix) * (dt / 0.45f > 1 ? 1 : dt / 0.45f);
  float per = 4.4f - 1.2f * mix;
  phase += dt / per;
  if (phase >= 1) phase -= 1;
  float k = 0.5f - 0.5f * cosf(2 * PI * phase);
  k = k * k * (3 - 2 * k);   // у краёв ещё мягче: в «паузах» вдоха яркость почти стоит
  float v = 1.5f + (LED_MAX - 1.5f) * k;
  float fr = v * mix, fg = v * (1 - 0.4f * mix);   // зелёный → жёлтый (красный + 0,6 зелёного)
  fr += errR;
  fg += errG;
  uint8_t r = (uint8_t)fr, gg = (uint8_t)fg;
  errR = fr - r;
  errG = fg - gg;
  ledState = mix > 0.5f ? 3 : 2;
  ledSet(r, gg, 0);
}

// Светодиод ведёт своя задача, 200 раз в секунду: плавность «дыхания» держится на частом «дрожании» между соседними
// уровнями яркости, а задача экрана идёт с частотой кадров (60 в секунду) — на ней дрожание было бы видно как мерцание.
static void ledTask(void *) {
  for (int pin : { 48, 38 }) rgbLedWrite(pin, 0, 0, 0);   // светодиод платы: с первой секунды под управление
  TickType_t t = xTaskGetTickCount();
  for (;;) {
    ledTick(millis());
    vTaskDelayUntil(&t, pdMS_TO_TICKS(5));
  }
}
